## meta-iot2000-bsp/conf/layer.conf
```bitbake
# We have a conf and classes directory, add to BBPATH
BBPATH .= ":${LAYERDIR}"

# We have a recipes-* directories, add to BBFILES
BBFILES += "${LAYERDIR}/recipes-*/*/*.bb \
	${LAYERDIR}/recipes-*/*/*.bbappend"

BBFILE_COLLECTIONS += "iot2000-bsp"
BBFILE_PATTERN_iot2000-bsp = "^${LAYERDIR}/"
BBFILE_PRIORITY_iot2000-bsp = "6"

LAYERSERIES_COMPAT_iot2000-bsp = "rocko sumo thud"

IOT2000_MIT_LICENSE = "${LAYERDIR}/COPYING.MIT"
IOT2000_GPLv2_LICENSE = "${LAYERDIR}/COPYING.GPLv2"

PACKAGE_CLASSES = "package_ipk"

PREFERRED_VERSION_stress = "1.%"
```

## meta-iot2000-bsp/conf/machine/include/intel-quark-common.inc
```bitbake
#
# Common configuration for all MACHINES of the intel-quark type
#

DEFAULTTUNE ?= "i586-nlp-32"
require conf/machine/include/tune-i586-nlp.inc
require conf/machine/include/x86-base.inc

# gnutls padlock code uses CMOV instruction in assembly which
# is not valid for Quark.
EXTRA_OECONF:append:pn-gnutls_intel-quark = " --disable-padlock"
EXTRA_OECONF:append:pn-openssl_intel-quark = " no-asm" 
```

## meta-iot2000-bsp/conf/machine/iot2000.conf
```bitbake
#@TYPE: Machine
#@NAME: iot2000

#@DESCRIPTION: Machine configuration for iot2000 systems

MACHINEOVERRIDES =. "intel-quark:"

PREFERRED_PROVIDER_virtual/kernel ?= "linux-cip"

require conf/machine/include/intel-quark-common.inc

MACHINE_FEATURES = "efi usb"

MACHINE_EXTRA_RRECOMMENDS += "kernel-modules linux-firmware"

SERIAL_CONSOLE = "115200 ttyS1"
APPEND += "rootwait console=ttyS1,115200 console=tty0"

EFI_PROVIDER = "systemd-boot"

# Ensure that the Lock prefix is omitted for the kernel
KERNEL_EXTRA_ARGS = "EXTRA_CFLAGS=-Wa,-momit-lock-prefix=yes"

# Machine specific Image packages:
IMAGE_INSTALL_append = " kernel-modules"

# Package compatiblity:
PACKAGE_EXTRA_ARCHS_append = " intel-quark quark i586 x86"

# Enable connman celluar
PACKAGECONFIG_append_pn-connman = " 3g"

INITRD_LIVE_prepend = "${DEPLOY_DIR_IMAGE}/acpi-upgrades-${MACHINE}.cpio "

# runqemu configuration
QB_MEM = "-m 1024"
QB_CPU = "-cpu pentium"
QB_CPU_KVM = "-cpu pentium"
QB_KERNEL_CMDLINE_APPEND = "console=ttyS1"
QB_OPT_APPEND = "-serial pty -serial mon:stdio -device virtio-rng-pci"
QB_NETWORK_DEVICE = "-device virtio-net-pci -device virtio-net-pci,netdev=net0,mac=@MAC@"
```

## meta-iot2000-bsp/scripts/lib/wic/canned-wks/core-image-minimal.iot2000.wks
```
# short-description: Create an Galileo Gen 1/2 disk image
# long-description: Creates a partitioned EFI disk image for Intel Galileo Gen 1/2,
# that the user can directly dd to boot media.

part /boot --source bootimg-efi --sourceparams="loader=gummiboot" --ondisk mmcblk0 --label msdos --active --align 1024

part / --source rootfs --ondisk mmcblk0 --fstype=ext3 --label platform --align 1024

bootloader  --timeout=0  --append="console=ttyS1,115200n8 reboot=efi,warm rw LABEL=boot debugshell=5"
```

## meta-iot2000-bsp/scripts/lib/wic/canned-wks/wic-image.iot2000.wks
```
# short-description: Create an iot2000 example disk image
# long-description: Creates a partitioned EFI disk image for the iot2000,
# using efibootguard, that the user can directly dd to boot media.

include common.iot2000.wks.header.inc

part / --source rootfs --ondisk mmcblk0 --fstype=ext4 --label platform --align 1024

include common.iot2000.wks.footer.inc
```

## meta-iot2000-example/conf/distro/include/define_java_providers.inc
```bitbake
# define known-to-work configuration
PREFERRED_RPROVIDER_java2-runtime = "cacao"
PREFERRED_PROVIDER_virtual/java-native = "cacao-native"
PREFERRED_PROVIDER_virtual/java-initial-native = "cacao-initial-native"
```

## meta-iot2000-example/conf/distro/poky-iot2000.conf
```bitbake
require conf/distro/poky.conf

DISTRO = "poky-iot2000"
DISTRO_NAME = "IOT2000 Example Image"
DISTRO_VERSION = "V4.0.0"

BINDINGS:pn-mraa = "python nodejs"
```

## meta-iot2000-example/conf/layer.conf
```bitbake
# We have a conf and classes directory, add to BBPATH
BBPATH .= ":${LAYERDIR}"

# We have a recipes-* directories, add to BBFILES
BBFILES += "${LAYERDIR}/recipes-*/*/*.bb \
	${LAYERDIR}/recipes-*/*/*.bbappend"

BBFILE_COLLECTIONS += "iot2000-example"
BBFILE_PATTERN_iot2000-example = "^${LAYERDIR}/"
BBFILE_PRIORITY_iot2000-example = "6"

LAYERDEPENDS_iot2000-example += " \
	iot2000-bsp \
	"

LAYERSERIES_COMPAT_iot2000-example = "zeus"

IOT2000_MIT_LICENSE = "${LAYERDIR}/COPYING.MIT"
IOT2000_GPLv2_LICENSE = "${LAYERDIR}/COPYING.GPLv2"
```

## meta-iot2000-example/scripts/lib/wic/canned-wks/example-image.iot2000.swupdate.wks
```
# short-description: Create an iot2000 example disk image for swupdate
# long-description: Creates a partitioned EFI disk image for the iot2000,
# using efibootguard, that the user can directly dd to boot media.

include common.iot2000.wks.header.inc

part --source efibootguard-boot --size 32 --extra-space 0 --overhead-factor 1 --ondisk mmcblk0 --label boot1 --align 1024 --part-type=0700 --sourceparams "watchdog=60,revision=1,initrd=acpi-upgrades-iot2000.cpio"
part / --source rootfs --size 2048 --extra-space 0 --overhead-factor 1 --ondisk mmcblk0 --fstype=ext4 --label platform0 --align 1024
part --size 2048 --extra-space 0 --overhead-factor 1 --ondisk mmcblk0 --fstype=ext4 --label plaftorm1 --align 1024
part swap --ondisk mmcblk0 --size 512 --fstype=swap --label swap --align 1024
part /data --size 1024 --extra-space 0 --overhead-factor 1 --ondisk mmcblk0 --label persistent --align 1024 --fstype=ext4

include common.iot2000.wks.footer.inc
```

## meta-iot2000-example/scripts/lib/wic/canned-wks/example-image.iot2000.wks
```
include common.iot2000.wks.header.inc

part swap --ondisk mmcblk0 --size 512 --fstype=swap --label swap --align 1024
part / --source rootfs --fstype=ext4 --label platform --align 1024 --use-uuid

include common.iot2000.wks.footer.inc
```
